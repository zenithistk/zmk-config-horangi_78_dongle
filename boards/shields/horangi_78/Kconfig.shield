## boards/shields/horangi_78/Kconfig.shield
```kconfig
config SHIELD_HORANGI_78_DONGLE
    def_bool $(shields_list_contains,horangi_78_dongle)

config SHIELD_HORANGI_78_LEFT
    def_bool $(shields_list_contains,horangi_78_left)

config SHIELD_HORANGI_78_RIGHT
    def_bool $(shields_list_contains,horangi_78_right)
```

## boards/shields/horangi_78_dongle/Kconfig.shield
```kconfig
config SHIELD_HORANGI_78_DONGLE
    def_bool $(shields_list_contains,horangi_78_dongle)
```

## config/boards/shields/horangi_78/Kconfig.defconfig
```kconfig
if SHIELD_HORANGI_78_LEFT || SHIELD_HORANGI_78_RIGHT

config ZMK_SPLIT
    default y

endif
```
